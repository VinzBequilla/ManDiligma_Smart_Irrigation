#include <DHT.h>
#include <Arduino_KNN.h>

// Pin definitions
#define SOIL_PIN A0
#define PUMP_PIN 3
#define DHT_PIN 2
#define DHT_TYPE DHT22

// Relay configuration
#define RELAY_ACTIVE_LOW false

// k-NN parameters
const int NUM_FEATURES = 3;
const int K = 3;
const int NUM_SAMPLES = 200; // Full dataset size
KNNClassifier knn(NUM_FEATURES);

// Adjusted dataset (200 samples, 3 features each: moisture, temp, hum)
float dataset[NUM_SAMPLES][NUM_FEATURES] = {
  {0.2360, 0.3805, 0.6063}, {0.5618, 0.3789, 0.6069},
  {0.0562, 0.1829, 1.0000}, {0.3596, 0.3805, 0.6069},
  {0.3034, 0.3797, 0.6061}, {0.2472, 0.3798, 0.6059},
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  {0.4382, 0.3801, 0.6070}, {0.9775, 0.3792, 0.6092}
};

// Labels (200 samples)
int labels[NUM_SAMPLES] = {
  1, 1, 1, 1, 0, 1, 1, 0, 0, 0, 0, 1, 0, 1, 1, 1, 0, 1, 1, 1,
  1, 1, 0, 1, 0, 0, 1, 1, 1, 0, 1, 0, 1, 0, 0, 1, 1, 0, 0, 1,
  1, 1, 1, 1, 1, 1, 1, 1, 0, 1, 1, 1, 0, 1, 0, 0, 0, 0, 1, 0,
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  0, 1, 0, 1, 1, 0, 1, 0, 1, 0, 0, 0, 1, 1, 1, 1, 0, 1, 1, 1
};
const float mins[NUM_FEATURES] = {1.00, 11.22, 0.59};
const float maxs[NUM_FEATURES] = {90.00, 45.56, 96.00};

// Global objects and variables
DHT dht(DHT_PIN, DHT_TYPE);

void setup() {
  pinMode(PUMP_PIN, OUTPUT);
  digitalWrite(PUMP_PIN, RELAY_ACTIVE_LOW ? HIGH : LOW); // Pump OFF
  Serial.begin(9600);
  dht.begin();

  // Initialize k-NN classifier
  for (int i = 0; i < NUM_SAMPLES; i++) {
    knn.addExample(dataset[i], labels[i]);
  }

  Serial.println("Arduino ready!");
}

void loop() {
  // Read and validate sensors
  float moisture, temp, hum;
  if (!readSensors(&moisture, &temp, &hum)) {
    Serial.println("Sensor read failed, retrying...");
    delay(5000);
    return;
  }

  // Normalize inputs for k-NN
  float new_point[NUM_FEATURES];
  normalizeInputs(moisture, temp, hum, new_point);

  // Run k-NN prediction
  int prediction = knn.classify(new_point, K);
  Serial.print("Predicted Status: ");
  Serial.println(prediction ? "ON" : "OFF");

  // Control pump
  controlPump(prediction);

  delay(5000); // Check every 5 seconds
}

bool readSensors(float* moisture, float* temp, float* hum) {
  // Read soil moisture
  int raw_moisture = analogRead(SOIL_PIN);
  if (raw_moisture < 0 || raw_moisture > 1023) {
    return false;
  }
  *moisture = 100 - (raw_moisture / 1023.0 * 100); // Convert to dryness %

  // Read DHT sensor
  *temp = dht.readTemperature();
  *hum = dht.readHumidity();
  if (isnan(*temp) || isnan(*hum)) {
    *temp = 25.0;
    *hum = 60.0;
  }

  // Validate readings
  if (*moisture < 0 || *moisture > 100 || *temp < -40 || *temp > 80 || *hum < 0 || *hum > 100) {
    return false;
  }

  // Print sensor data
  Serial.print("Moisture: "); Serial.print(*moisture);
  Serial.print(", Temp: "); Serial.print(*temp);
  Serial.print(", Humidity: "); Serial.println(*hum);

  return true;
}

void normalizeInputs(float moisture, float temp, float hum, float* new_point) {
  new_point[0] = constrain((moisture - mins[0]) / (maxs[0] - mins[0]), 0, 1);
  new_point[1] = constrain((temp - mins[1]) / (maxs[1] - mins[1]), 0, 1);
  new_point[2] = constrain((hum - mins[2]) / (maxs[2] - mins[2]), 0, 1);

  // Debug normalized inputs
  Serial.print("Normalized inputs: ");
  for (int i = 0; i < NUM_FEATURES; i++) {
    Serial.print(new_point[i], 4); Serial.print(" ");
  }
  Serial.println();
}

void controlPump(int prediction) {
  if (prediction == 1) {
    Serial.println("Activating pump...");
    digitalWrite(PUMP_PIN, RELAY_ACTIVE_LOW ? LOW : HIGH);
    delay(6000); // Run pump for 6 seconds
    digitalWrite(PUMP_PIN, RELAY_ACTIVE_LOW ? HIGH : LOW);
    Serial.println("Pump state: OFF (after 6s)");
  }
}